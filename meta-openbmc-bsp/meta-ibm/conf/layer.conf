## meta-openbmc-bsp/meta-ibm/conf/layer.conf
```bitbake
# We have a conf and classes directory, add to BBPATH
BBPATH .= ":${LAYERDIR}"

# We have recipes-* directories, add to BBFILES
BBFILES += "${LAYERDIR}/common/recipes-*/*/*.bb \
            ${LAYERDIR}/common/recipes-*/*/*.bbappend"

BBFILE_COLLECTIONS += "ibm"
BBFILE_PATTERN_ibm = "^${LAYERDIR}/"
LAYERVERSION_ibm = "1"
```

## meta-openbmc-bsp/meta-ibm/meta-fsp2/conf/layer.conf
```bitbake
# We have a conf and classes directory, add to BBPATH
BBPATH .= ":${LAYERDIR}"

# We have recipes-* directories, add to BBFILES
BBFILES += "${LAYERDIR}/recipes-*/*/*.bb \
            ${LAYERDIR}/recipes-*/*/*.bbappend"

BBFILE_COLLECTIONS += "ibm"
BBFILE_PATTERN_ibm = "^${LAYERDIR}/"
BBFILE_PRIORITY_ibm = "5"
LAYERVERSION_ibm = "3"
```

## meta-openbmc-bsp/meta-ibm/meta-fsp2/conf/machine/fsp2.conf
```bitbake
#@TYPE: Machine
#@DESCRIPTION: Machine configuration for running 

TARGET_FPU = ""

COMPATIBLE_MACHINE_fsp2 = "fsp2"

require conf/machine/include/powerpc/arch-powerpc.inc

SERIAL_CONSOLE = "115200 ttyS0"

MACHINE_FEATURES = "keyboard pci ext2 ext3 serial"

# Temporary fix
PREFERRED_PROVIDER_virtual/kernel = "linux-yocto-fsp2"
#PREFERRED_PROVIDER_virtual/kernel = "linux-yocto-fsp2-dd-test"

PREFERRED_PROVIDER_virtual/xserver ?= "xserver-xorg"
XSERVER ?= "xserver-xorg \
            xf86-video-fbdev"


KERNEL_DEVICETREE = "fsp2.dtb"

MACHINE_EXTRA_RRECOMMENDS = " kernel-modules"


UBOOT_ENTRYPOINT = "0x01400000"

IMAGE_FSTYPES ?= "cpio.gz"

EXTRA_USERS_PARAMS = "useradd -P password fsp2;   usermod -P password root; "
```

## meta-openbmc-bsp/meta-ibm/meta-fsp2/conf/machine/pscnx86.conf
```bitbake
#@TYPE: Machine
#@DESCRIPTION: Machine configuration for running 

TARGET_FPU = ""

COMPATIBLE_MACHINE_pscnx86 = "pscnx86"

DEFAULTTUNE ?= "x86-64"
require conf/machine/include/x86/arch-x86.inc

SERIAL_CONSOLE = "115200 ttyS0"

MACHINE_FEATURES = "keyboard pci ext2 ext3 serial"
#PREFERRED_PROVIDER_virtual/kernel = "linux-dummy"
PREFERRED_PROVIDER_virtual/xserver ?= "xserver-xorg"
XSERVER ?= "xserver-xorg \
            xf86-video-fbdev"

KERNEL_DEVICETREE = "fsp2.dtb"
MACHINE_EXTRA_RRECOMMENDS = " kernel-modules"


UBOOT_ENTRYPOINT = "0x01400000"
IMAGE_FSTYPES ?= "cpio.gz"

MACHINE_FEATURES += "x86"

BASELIB ??="lib64"
```
